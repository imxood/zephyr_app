## CMakeLists.txt
```
cmake_minimum_required(VERSION 3.13.1)

include($ENV{ZEPHYR_BASE}/cmake/app/boilerplate.cmake NO_POLICY_SCOPE)
project(base)

FILE(
	GLOB_RECURSE app_sources
	src/main.c
	# src/test_section.c
)

target_sources(app PRIVATE ${app_sources})

zephyr_linker_sources(SECTIONS link/custom-sections.ld)
```

## Kconfig
```
source "Kconfig.zephyr"

menu "Zepgyr Esp32 Wifi"



endmenu
```

## prj.conf
```kconfig
# Shell
CONFIG_SHELL=y
CONFIG_UART_SHELL_ON_DEV_NAME="ROMUART"
# CONFIG_LOG=y
# CONFIG_LOG_BACKEND_UART=y
# CONFIG_CODE_DATA_RELOCATION=y

# CONFIG_HAVE_CUSTOM_LINKER_SCRIPT=y
# CONFIG_CUSTOM_LINKER_SCRIPT="link/linker.ld"
```

## src/main.c
```c
#include "main.h"

#include <zephyr.h>
#include <sys/printk.h>

extern void test_section();

void main(void)
{
	// test_section();

	while(1) {
		printk("Hello World! %s\n", CONFIG_BOARD);
		k_sleep(5000);
	}
}
```

## src/main.h
```c
#pragma once

/* Test Userspace */
extern void test_userspace(void);
```
