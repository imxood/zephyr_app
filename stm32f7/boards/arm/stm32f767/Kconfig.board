## stm32f7/boards/arm/stm32f767/Kconfig.board
```kconfig
# Kconfig - STM32F767 Discovery board configuration
#
# Copyright (c) 2018 Yong Jin
#
# SPDX-License-Identifier: Apache-2.0
#

config BOARD_STM32F767
	bool "STM32F767 Discovery Development Board"
	depends on SOC_STM32F767XX
```

## stm32f7/boards/arm/stm32f767/Kconfig.defconfig
```kconfig
# Kconfig - STM32F767 DISCOVERY board configuration
#
# Copyright (c) 2018 Yong Jin
#
# SPDX-License-Identifier: Apache-2.0
#

if BOARD_STM32F767

config BOARD
	default "stm32f767"

if UART_CONSOLE

config UART_1
	default y

endif # UART_CONSOLE

if SERIAL

config UART_6
	default y

endif # SERIAL

if SPI

config SPI_STM32_INTERRUPT
	default y

endif # SPI

if NETWORKING

config NET_L2_ETHERNET
	default y

config ETH_STM32_HAL
	default y

endif # NETWORKING

endif # BOARD_STM32F767
```
